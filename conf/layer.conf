## conf/layer.conf
```bitbake
BBPATH := "${BBPATH}:${LAYERDIR}"

BBFILES := "${BBFILES} ${LAYERDIR}/recipes-*/*/*.bb ${LAYERDIR}/recipes-*/*/*.bappend"

BBFILE_COLLECTIONS += "ntb"

BBFILE_PATTERN_ntb := "^${LAYERDIR}/"
BBFILE_PRIORITY_ntb := "5"
```

## conf/machine/cx2020.conf
```bitbake
DESCRIPTION = "Beckhoff CX2020 PLC"

require conf/machine/genericx86-64.conf

PREFERRED_PROVIDER_virtual/kernel = "linux-yocto-rt"

KMACHINE_cx2020 = "qemux86-64"
```

## meta-ntb-ros/conf/layer.conf
```bitbake
BBPATH =. "${LAYERDIR}:"

BBFILES += "${LAYERDIR}/recipes-*/*/*.bb \
            ${LAYERDIR}/recipes-*/*/*.bbappend"

BBFILE_COLLECTIONS += "ntb-ros"

BBFILE_PATTERN_ntb-ros := "^${LAYERDIR}/"
BBFILE_PRIORITY_ntb-ros := "5"
```

## meta-ntb-ti/conf/layer.conf
```bitbake
BBPATH =. "${LAYERDIR}:"

BBFILES += "${LAYERDIR}/recipes-*/*/*.bb \
            ${LAYERDIR}/recipes-*/*/*.bbappend"

BBFILE_COLLECTIONS += "ntb-ti"

BBFILE_PATTERN_ntb-ti := "^${LAYERDIR}/"
BBFILE_PRIORITY_ntb-ti := "5"
```

## meta-ntb-toradex/conf/layer.conf
```bitbake
BBPATH =. "${LAYERDIR}:"

BBFILES += "${LAYERDIR}/recipes-*/*/*.bb \
            ${LAYERDIR}/recipes-*/*/*.bbappend"

BBFILE_COLLECTIONS += "ntbtdx"

BBFILE_PATTERN_ntbtdx := "^${LAYERDIR}/"
BBFILE_PRIORITY_ntbtdx := "5"
```

## meta-ntb-toradex/conf/machine/cb20.conf
```bitbake
require conf/machine/colibri-imx6.conf

KERNEL_DEVICETREE += "imx6dl-colibri-cb20.dtb"

# PREFERRED_PROVIDER_virtual/kernel = "linux-toradex-rt"

COMPATIBLE_MACHINE_cb20 = "cb20"

KBUILD_DEFCONFIG_cb20 = "colibri_imx6_defconfig"
```

## meta-ntb/conf/distro/ntb-distro.conf
```bitbake
require conf/distro/poky.conf  
include conf/distro/include/tdx-base.inc


DISTRO = "ntb-distro"  
DISTRO_NAME = "Poky based distribution with NTB specific addendums"  
DISTRO_VERSION = "1.0"  
DISTRO_FEATURES_append = " systemd"  
# uncomment the following two line two use directfb  
#DISTRO_FEATURES_append = " directfb"  
DISTRO_FEATURES_remove = " x11 wayland"  
DISTRO_EXTRA_RDEPENDS += "\  
   initscripts \  
   systemd \  
   systemd-analyze \
   "   
# Switch init-system to systemd  
VIRTUAL-RUNTIME_init_manager = "systemd"  
DISTRO_FEATURES_BACKFILL_CONSIDERED = "sysvinit"  
VIRTUAL-RUNTIME_initscripts = ""
PACKAGE_CLASSES = "package_ipk"

# needed for toradex boards to build RT kernel
DISTROOVERRIDES .= ":tdx:preempt-rt"
DISTRO_FLAVOUR = " (PREEMPT_RT)"
TDX_MATRIX_BUILD_TIME = "${DATETIME}"
TDX_MATRIX_BUILD_TIME[vardepsexclude] = "DATETIME"

PREFERRED_PROVIDER_u-boot-fw-utils = "libubootenv"
PREFERRED_RPROVIDER_u-boot-fw-utils = "libubootenv"
PREFERRED_PROVIDER_virtual/dtb ?= "device-tree-overlays"
```

## meta-ntb/conf/layer.conf
```bitbake
BBPATH =. "${LAYERDIR}:"

BBFILES += "${LAYERDIR}/recipes-*/*/*.bb \
            ${LAYERDIR}/recipes-*/*/*.bbappend"

BBFILE_COLLECTIONS += "ntb"

BBFILE_PATTERN_ntb := "^${LAYERDIR}/"
BBFILE_PRIORITY_ntb := "5"
```

## meta-ntb/conf/machine/bblue.conf
```bitbake
DESCRIPTION = "Beagleboard Beaglebone Blue"

require conf/machine/beaglebone-yocto.conf

PREFERRED_PROVIDER_virtual/kernel = "linux-yocto-rt"

KERNEL_DEVICETREE_append = " am335x-boneblue.dtb"

# add bblue dtb to u-boot partition
IMAGE_BOOT_FILES_append = " am335x-boneblue.dtb"

IMAGE_FSTYPES += "wic"

COMPATIBLE_MACHINE_bblue = "bblue"

# set udhcpc to use wifi adapter (rather than ethernet)
UDHCPC_OPTS = "-i wlan0"

MACHINE_ESSENTIAL_EXTRA_RRECOMMENDS += "kernel-modules"
```

## meta-ntb/conf/machine/c6930.conf
```bitbake
DESCRIPTION = "Beckhoff CX2020 PLC"

require conf/machine/genericx86-64.conf

#PREFERRED_PROVIDER_virtual/kernel = "linux-yocto"
#PREFERRED_PROVIDER_virtual/kernel = "linux-yocto-custom"
PREFERRED_PROVIDER_virtual/kernel = "linux-yocto-custom-rt"
KMACHINE_c6930 = "qemux86-64"
```

## meta-ntb/conf/machine/cx2020.conf
```bitbake
DESCRIPTION = "Beckhoff CX2020 PLC"

require conf/machine/genericx86-64.conf

#PREFERRED_PROVIDER_virtual/kernel = "linux-yocto"
#PREFERRED_PROVIDER_virtual/kernel = "linux-yocto-custom"
PREFERRED_PROVIDER_virtual/kernel = "linux-yocto-custom-rt"
KMACHINE_cx2020 = "qemux86-64"
```

## meta-ntb/conf/machine/x86-rt.conf
```bitbake
DESCRIPTION = "generic x86_64 machine with RT kernel"

require conf/machine/genericx86-64.conf

#PREFERRED_PROVIDER_virtual/kernel = "linux-yocto"
#PREFERRED_PROVIDER_virtual/kernel = "linux-yocto-custom"
PREFERRED_PROVIDER_virtual/kernel = "linux-yocto-rt"
KMACHINE_x86-rt = "qemux86-64"
COMPATIBLE_MACHINE_x86-rt = "x86-rt"
```
